## conf/layer.conf
```bitbake
# We have a conf and classes directory, add to BBPATH
BBPATH .= ":${LAYERDIR}"

# We have recipes-* directories, add to BBFILES
BBFILES += "${LAYERDIR}/recipes-*/*/*.bb \
	${LAYERDIR}/recipes-*/*/*.bbappend"

BBFILE_COLLECTIONS += "timesys-tsu"
BBFILE_PATTERN_timesys-lab = "^${LAYERDIR}/"
BBFILE_PRIORITY_timesys-lab = "6"
```
